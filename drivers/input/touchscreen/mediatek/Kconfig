## drivers/input/touchscreen/mediatek/Kconfig
```kconfig
#
# Touchscreen driver configuration
#
menuconfig INPUT_TOUCHSCREEN
	bool "Touchscreens"
	help
	  Say Y here, and a list of supported touchscreens will be displayed.
	  This option doesn't affect the kernel.

	  If unsure, say Y.

if INPUT_TOUCHSCREEN

source "drivers/input/touchscreen/mediatek/GT1151/Kconfig"
source "drivers/input/touchscreen/mediatek/oppo_16011_gt915/Kconfig"
source "drivers/input/touchscreen/mediatek/oppo_15127_s3203/Kconfig"
source "drivers/input/touchscreen/mediatek/oppo_15131_ft5336/Kconfig"
source "drivers/input/touchscreen/mediatek/oppo_16021_gt5688/Kconfig"
endif
```

## drivers/misc/mediatek/magnetometer/mmc3416x-new/Kconfig
```kconfig
config MTK_MMC3416X_NEW
	bool "MTK_MMC3416X_NEW for MediaTek package"
	default n
```

## drivers/misc/mediatek/magnetometer/yamaha533-new/Kconfig
```kconfig
config MTK_YAS533_NEW
        bool "YAS533 for Mediatek package"
        default n
```

## drivers/misc/mediatek/magnetometer/yamaha537/Kconfig
```kconfig
config MTK_YAS537
        bool "YAS537 for Mediatek package"
        default n
	help
	  It support different magnetometer sensor.
          If this option is set,
	  it will support
          Yamaha537 magnetometer.
```

## drivers/misc/mediatek/pmic/Kconfig
```kconfig
# PMIC driver

# New SW architecture for Mediatek PMIC driver
config MTK_PMIC_NEW_ARCH
	tristate "MediaTek Power Management Unit Driver"
	default n
	---help---
	  Mediatek PMIC Driver

config MTK_PMIC_CHIP_MT6353
	tristate "MediaTek Power Management Unit Driver"
	default n
	---help---
	  Mediatek PMIC Driver

if MTK_LDVT
config MTK_LDVT_PMIC
	bool "MediaTek PMIC driver for LDVT"
	default y
	---help---
	  MediaTek PMIC driver for LDVT
endif
```

## drivers/misc/mediatek/rgb_sensor/Kconfig
```kconfig
config CUSTOM_KERNEL_RGB_SENSOR
	bool "CUSTOM_KERNEL_RGB_SENSOR"
	help
	  RGB sensor driver to mesure the RGB light 

config MTK_TCS3490
        tristate "TCS3490 Sensor Driver"
        help
          This option enables support for the TCS3490 Sensor Driver.

          To compile this driver as a module, choose M here. The module will
          be called tcs3490.

config MTK_NXU8010
        tristate "NXU8010 Sensor Driver"
        help
          This option enables support for the NXU8010 Sensor Driver.

          To compile this driver as a module, choose M here. The module will
          be called NXU8010.
```

## drivers/misc/mediatek/rgb_sensor/nxu8010/Kconfig
```kconfig
config MTK_TCS3490
        tristate "TCS3490 Sensor Driver"
        help
          This option enables support for the ams TCS3490 Sensor Driver.

          To compile this driver as a module, choose M here. The module will
          be called tcs3490.
```

## drivers/misc/mediatek/spm/Kconfig
```kconfig
config MTK_SPM
	bool "Enable MTK SPM suspend function"
	depends on SUSPEND
	default y if SUSPEND
	help
	  Enable MTK SPM suspend function.

config MTK_SPM_USE_EXT_BUCK
	bool "MTK SPM use ext buck"
	default n
	help
	  Vmd1 is controled by an ext buck. If you want to use ext buck for
	  Vmd1, set y here, or it dependeds on the efuse value.
```

## drivers/misc/mediatek/usb_typec/Kconfig
```kconfig
#
# MediaTek USB USB TYPEC Driver
#

config MTK_TYPEC_SWITCH
        bool "MediaTek USB TYPE-C Driver"
        default n
	---help---
	  Enables support usb type-c.
	  If unsure, say N.

config MTK_TYPEC_SWITCH_FUSB302
	bool "MediaTek USB TYPE-C Driver with external solution (FUSB302)"
	default n
	---help---
	  Enables support usb type-c and FUSB302.
	  If unsure, say N.

config MTK_TYPEC_SWITCH_MT6353
	bool "MediaTek USB TYPE-C Driver (MT6353)"
	default n
	---help---
	  Enables support MT6353 USB TYPE-C (CC only).
	  If unsure, say N.
```

## drivers/soc/oppo/Kconfig
```kconfig
#ifdef VENDOR_EDIT
#//wenbin.liu@PSW.Kernel.MM, 2018/05/23, Add for Healthinfo monitor
source "drivers/soc/oppo/oppo_healthinfo/Kconfig"
#endif /* VENDOR_EDIT */
```
